## configs/eurobot_raspberry2_exp_2019_defconfig
```kconfig
BR2_arm=y
BR2_cortex_a7=y
BR2_ARM_FPU_NEON_VFPV4=y
BR2_PACKAGE_HOST_LINUX_HEADERS_CUSTOM_4_14=y
BR2_UCLIBC_CONFIG_FRAGMENT_FILES="board/eurobot/raspberry2/uclicb-extra.config"
BR2_TOOLCHAIN_BUILDROOT_CXX=y
BR2_SYSTEM_DHCP="eth0"
BR2_ROOTFS_OVERLAY="board/eurobot/raspberry2/rootfs_overlay"
BR2_ROOTFS_POST_BUILD_SCRIPT="board/eurobot/raspberry2/post-build.sh board/eurobot/raspberry2/keys-post-build.sh"
BR2_ROOTFS_POST_IMAGE_SCRIPT="board/raspberrypi2/post-image.sh"
BR2_ROOTFS_POST_SCRIPT_ARGS="--enable-i2c"
BR2_LINUX_KERNEL=y
BR2_LINUX_KERNEL_CUSTOM_TARBALL=y
BR2_LINUX_KERNEL_CUSTOM_TARBALL_LOCATION="$(call github,raspberrypi,linux,865ddc1393f558198e7e7ce70928ff2e49c4f7f6)/linux-865ddc1393f558198e7e7ce70928ff2e49c4f7f6.tar.gz"
BR2_LINUX_KERNEL_USE_CUSTOM_CONFIG=y
BR2_LINUX_KERNEL_CUSTOM_CONFIG_FILE="board/eurobot/raspberry2/linux.config"
BR2_LINUX_KERNEL_DTS_SUPPORT=y
BR2_LINUX_KERNEL_INTREE_DTS_NAME="bcm2709-rpi-2-b"
BR2_PACKAGE_LINUX_FIRMWARE=y
BR2_PACKAGE_LINUX_FIRMWARE_RTL_81XX=y
BR2_PACKAGE_RPI_FIRMWARE=y
# BR2_PACKAGE_RPI_FIRMWARE_INSTALL_DTB_OVERLAYS is not set
BR2_PACKAGE_RNG_TOOLS=y
BR2_PACKAGE_HOSTAPD=y
# BR2_PACKAGE_HOSTAPD_VLAN is not set
BR2_PACKAGE_IW=y
BR2_PACKAGE_OPENSSH=y
BR2_PACKAGE_WIRELESS_TOOLS=y
BR2_PACKAGE_WPA_SUPPLICANT=y
BR2_PACKAGE_WPA_SUPPLICANT_AP_SUPPORT=y
BR2_TARGET_ROOTFS_EXT2=y
BR2_TARGET_ROOTFS_EXT2_4=y
BR2_TARGET_ROOTFS_EXT2_SIZE="120M"
# BR2_TARGET_ROOTFS_TAR is not set
BR2_PACKAGE_HOST_DOSFSTOOLS=y
BR2_PACKAGE_HOST_GENIMAGE=y
BR2_PACKAGE_HOST_MTOOLS=y
```

## configs/robot_raspberrypi0_defconfig
```kconfig
BR2_arm=y
BR2_arm1176jzf_s=y
BR2_TOOLCHAIN_BUILDROOT_GLIBC=y
BR2_PACKAGE_HOST_LINUX_HEADERS_CUSTOM_4_14=y
BR2_TOOLCHAIN_BUILDROOT_CXX=y
BR2_ROOTFS_DEVICE_CREATION_DYNAMIC_MDEV=y
BR2_ROOTFS_OVERLAY="board/robot/rootfs_overlay"
BR2_ROOTFS_POST_BUILD_SCRIPT="board/robot/post-build.sh"
BR2_ROOTFS_POST_IMAGE_SCRIPT="board/raspberrypi0/post-image.sh"
BR2_ROOTFS_POST_SCRIPT_ARGS="--enable-i2c"
BR2_LINUX_KERNEL=y
BR2_LINUX_KERNEL_CUSTOM_TARBALL=y
BR2_LINUX_KERNEL_CUSTOM_TARBALL_LOCATION="$(call github,raspberrypi,linux,865ddc1393f558198e7e7ce70928ff2e49c4f7f6)/linux-865ddc1393f558198e7e7ce70928ff2e49c4f7f6.tar.gz"
BR2_LINUX_KERNEL_DEFCONFIG="bcmrpi"
BR2_LINUX_KERNEL_DTS_SUPPORT=y
BR2_LINUX_KERNEL_INTREE_DTS_NAME="bcm2708-rpi-b-plus"
BR2_PACKAGE_BUSYBOX_SHOW_OTHERS=y
BR2_PACKAGE_LINUX_FIRMWARE=y
BR2_PACKAGE_LINUX_FIRMWARE_BRCM_BCM43XXX=y
BR2_PACKAGE_LINUX_FIRMWARE_RALINK_RT2XX=y
BR2_PACKAGE_LINUX_FIRMWARE_RTL_81XX=y
BR2_PACKAGE_RPI_FIRMWARE=y
# BR2_PACKAGE_RPI_FIRMWARE_INSTALL_DTB_OVERLAYS is not set
BR2_PACKAGE_RNG_TOOLS=y
BR2_PACKAGE_HOSTAPD=y
# BR2_PACKAGE_HOSTAPD_VLAN is not set
BR2_PACKAGE_IW=y
BR2_PACKAGE_OPENSSH=y
BR2_PACKAGE_WIRELESS_TOOLS=y
BR2_PACKAGE_WPA_SUPPLICANT=y
BR2_PACKAGE_WPA_SUPPLICANT_AP_SUPPORT=y
BR2_PACKAGE_ROBOT_CREDENTIALS=y
BR2_PACKAGE_BASH=y
BR2_PACKAGE_BASH_COMPLETION=y
BR2_PACKAGE_VIM=y
# BR2_PACKAGE_VIM_RUNTIME is not set
BR2_TARGET_ROOTFS_EXT2=y
BR2_TARGET_ROOTFS_EXT2_4=y
BR2_TARGET_ROOTFS_EXT2_SIZE="100M"
# BR2_TARGET_ROOTFS_TAR is not set
BR2_PACKAGE_HOST_DOSFSTOOLS=y
BR2_PACKAGE_HOST_GENIMAGE=y
BR2_PACKAGE_HOST_MTOOLS=y
```

## package/halpin/Config.in
```kconfig
config BR2_PACKAGE_HALPIN
    bool "halpin"
    help
        Halpin (Hardware Abstraction Layer PIN) is a library 
        to abstract the GPIO hardware and their functionality
        (i2c, serial, ...).

if BR2_PACKAGE_HALPIN

choice
	prompt "Halpin method"

config BR2_PACKAGE_HALPIN_CUSTOM_GIT
	bool "Custom Git repository"
	help
	  This option allows Buildroot to get the Halpin source
	  code from a Git repository.

config BR2_PACKAGE_HALPIN_CUSTOM_LOCAL
	bool "Custom Local directory"
	help
	  This option allows Buildroot to get the Halpin source
	  code from a local directory.

config BR2_PACKAGE_HALPIN_DEFAULT
	bool "Default"
	help
	  This option allows Buildroot to get the Halpin source
	  code from the default source.

endchoice

if BR2_PACKAGE_HALPIN_CUSTOM_GIT

config BR2_PACKAGE_HALPIN_CUSTOM_GIT_REPOSITORY
	string "URL of custom Git repository"

config BR2_PACKAGE_HALPIN_CUSTOM_GIT_VERSION
	string "Custom Git repository version"
endif

if BR2_PACKAGE_HALPIN_CUSTOM_LOCAL

config BR2_PACKAGE_HALPIN_CUSTOM_LOCAL_DIRECTORY
	string "Path of custom Local directory"

endif

choice
	prompt "Halpin configuration"
	default BR2_PACKAGE_HALPIN_USE_DEFCONFIG

config BR2_PACKAGE_HALPIN_USE_DEFCONFIG
	bool "Using an in-tree defconfig file"

config BR2_PACKAGE_HALPIN_USE_CUSTOM_CONFIG
	bool "Using a custom (def)config file"

endchoice

config BR2_PACKAGE_HALPIN_CONFIG
	string "Configuration file path"
	depends on BR2_PACKAGE_HALPIN_USE_DEFCONFIG
	help
	  Name of the defconfig

config BR2_PACKAGE_HALPIN_CUSTOM_CONFIG_FILE
	string "Configuration file path"
	depends on BR2_PACKAGE_HALPIN_USE_CUSTOM_CONFIG
	help
	  Path to the Halpin configuration file

config BR2_PACKAGE_HALPIN_BUILD_TESTS
	bool "Build Halpin tests"

endif
```

## package/robot-credentials/Config.in
```kconfig
config BR2_PACKAGE_ROBOT_CREDENTIALS
	bool "robot-credentials"
	help
	  This package install the credentials to the target.
```
